## conf/machine/varsomam33c.conf
```bitbake
#@TYPE: Machine
#@NAME: VAR-SOM-AM33C
#@DESCRIPTION: Machine configuration for Variscite VAR-SOM-AM33 customer version

require conf/machine/include/var-ti33x-common.inc


KERNEL_DEVICETREE_varsomam33c = "var-som-am33c.dtb var-som-am33.dtb"

PREFERRED_PROVIDER_virtual/kernel_varsomam33c = "linux-ti-variscite"
PREFERRED_PROVIDER_virtual/bootloader_varsomam33c = "u-boot-var-som-am33"
PREFERRED_PROVIDER_u-boot_varsomam33c = "u-boot-var-som-am33"
```

## conf/machine/varsomam33crt.conf
```bitbake
#@TYPE: Machine
#@NAME: VAR-SOM-AM33CRT
#@DESCRIPTION: Machine configuration for Variscite VAR-SOM-AM33 customer version with Linux RT patched

require conf/machine/include/var-ti33x-common.inc


KERNEL_DEVICETREE_varsomam33crt = "targetdevice.dtb var-som-am33.dtb"
KERNEL_DEVICETREE_NAND = "targetdevice.dtb"

PREFERRED_PROVIDER_virtual/kernel_varsomam33crt = "linux-ti-variscite"
PREFERRED_PROVIDER_virtual/bootloader_varsomam33crt = "u-boot-var-som-am33"
PREFERRED_PROVIDER_u-boot_varsomam33crt = "u-boot-var-som-am33"
```

## conf/machine/varsomam33cv1.conf
```bitbake
#@TYPE: Machine
#@NAME: VAR-SOM-AM33CV1
#@DESCRIPTION: Machine configuration for customer version Variscite VAR-SOM-AM33 1G Nand with 512KiB erase block size

require conf/machine/include/var-ti33x-common.inc


KERNEL_DEVICETREE_varsomam33cv1 = "targetdevice.dtb var-som-am33.dtb"
KERNEL_DEVICETREE_NAND = "targetdevice.dtb"

PREFERRED_PROVIDER_virtual/kernel_varsomam33cv1 = "linux-ti-variscite"
PREFERRED_PROVIDER_virtual/bootloader_varsomam33cv1 = "u-boot-var-som-am33"
PREFERRED_PROVIDER_u-boot_varsomam33cv1 = "u-boot-var-som-am33"

MKUBIFS_ARGS = "-F -m 4096 -e 504KiB -c 2000"
UBINIZE_ARGS = "-m 4096 -p 512KiB -s 4096 -O 4096"
```

## conf/machine/varsomam33cv1rt.conf
```bitbake
#@TYPE: Machine
#@NAME: VAR-SOM-AM33CV1RT
#@DESCRIPTION: Machine configuration for customer version Variscite VAR-SOM-AM33 1G Nand with 512KiB erase block size. RT patched.

require conf/machine/include/var-ti33x-common.inc


KERNEL_DEVICETREE_varsomam33cv1rt = "targetdevice.dtb var-som-am33.dtb"
KERNEL_DEVICETREE_NAND = "targetdevice.dtb"

PREFERRED_PROVIDER_virtual/kernel_varsomam33cv1rt = "linux-ti-variscite"
PREFERRED_PROVIDER_virtual/bootloader_varsomam33cv1rt = "u-boot-var-som-am33"
PREFERRED_PROVIDER_u-boot_varsomam33cv1rt = "u-boot-var-som-am33"

MKUBIFS_ARGS = "-F -m 4096 -e 504KiB -c 2000"
UBINIZE_ARGS = "-m 4096 -p 512KiB -s 4096 -O 4096"
```

## conf/machine/varsomam33cv2.conf
```bitbake
#@TYPE: Machine
#@NAME: VAR-SOM-AM33CV2
#@DESCRIPTION: Machine configuration for customer version Variscite VAR-SOM-AM33 1G Nand with 256KiB erase block size

require conf/machine/include/var-ti33x-common.inc


KERNEL_DEVICETREE_varsomam33cv2 = "targetdevice.dtb var-som-am33.dtb"
KERNEL_DEVICETREE_NAND = "targetdevice.dtb"

PREFERRED_PROVIDER_virtual/kernel_varsomam33cv2 = "linux-ti-variscite"
PREFERRED_PROVIDER_virtual/bootloader_varsomam33cv2 = "u-boot-var-som-am33"
PREFERRED_PROVIDER_u-boot_varsomam33cv2 = "u-boot-var-som-am33"

MKUBIFS_ARGS = "-F -m 4096 -e 248KiB -c 4000"
UBINIZE_ARGS = "-m 4096 -p 256KiB -s 4096 -O 4096"
```

## conf/machine/varsomam33cv2rt.conf
```bitbake
#@TYPE: Machine
#@NAME: VAR-SOM-AM33CV2RT
#@DESCRIPTION: Machine configuration for customer version Variscite VAR-SOM-AM33 1G Nand with 256KiB erase block size. RT patched.

require conf/machine/include/var-ti33x-common.inc


KERNEL_DEVICETREE_varsomam33cv2rt = "targetdevice.dtb var-som-am33.dtb"
KERNEL_DEVICETREE_NAND = "targetdevice.dtb"

PREFERRED_PROVIDER_virtual/kernel_varsomam33cv2rt = "linux-ti-variscite"
PREFERRED_PROVIDER_virtual/bootloader_varsomam33cv2rt = "u-boot-var-som-am33"
PREFERRED_PROVIDER_u-boot_varsomam33cv2rt = "u-boot-var-som-am33"

MKUBIFS_ARGS = "-F -m 4096 -e 248KiB -c 4000"
UBINIZE_ARGS = "-m 4096 -p 256KiB -s 4096 -O 4096"
```
